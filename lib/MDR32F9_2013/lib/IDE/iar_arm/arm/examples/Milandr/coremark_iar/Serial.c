/*----------------------------------------------------------------------------*/

#include "1986be91t1.h"                              /* 1986BE91T definitions    */
#include "Serial.h"

/*----------------------------------------------------------------------------
  Initialize UART pins, Baudrate
 *----------------------------------------------------------------------------*/
void SER_init () 
{
}


/*----------------------------------------------------------------------------
  Write character to Serial Port
 *----------------------------------------------------------------------------*/
int SER_putChar (unsigned char c) 
{
// Если есть куда, то записываем С в регистр данных
	while ((((UART2->FR)&0x0080))==0) {}; // буфер не занят
			UART2->DR =c;
	return 0;		 


}


/*----------------------------------------------------------------------------
  Read character from Serial Port   (blocking read)
 *----------------------------------------------------------------------------*/
int SER_getChar () 
{
		unsigned char t;
// Если есть что то читаем и возврящаем
		while ((((UART2->FR)&0x00000010))!=0) {};// буфер не пуст
		t = (unsigned char)(UART2->DR);
		return t;
}


/*----------------------------------------------------------------------------
  Read character from Serial Port   (non blocking read)
 *----------------------------------------------------------------------------*/
int SER_getChar_nb () 
{
	unsigned char t;
	// Если есть что то читаем и возврящаем иначе
	if ((((UART2->FR)&0x00000010))==0)
	{  // буфер не пуст
	t = (unsigned char)(UART2->DR);
	return t;
	}
	 else
    return 0;
}


/*----------------------------------------------------------------------------
  Write character to Serial Port
 *----------------------------------------------------------------------------*/
void SER_putString (unsigned char *s) {

  while (*s != 0) {
   SER_putChar(*s++);
  }
}
